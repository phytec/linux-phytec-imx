// SPDX-License-Identifier: (GPL-2.0+ OR MIT)
/*
 * Copyright (C) 2025 PHYTEC Messtechnik GmbH
 * Author: Stefan Riedmüller <s.riedmueller@phytec.de>
 */

&cameradev {
	status = "okay";
};

&isi_0 {
	dma-coherent;
	status = "okay";

	cap_device {
		status = "okay";
	};
};

&mipi_csi_0 {
	status = "okay";
};
