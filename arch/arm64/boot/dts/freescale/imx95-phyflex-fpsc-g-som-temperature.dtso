// SPDX-License-Identifier: (GPL-2.0+ OR MIT)
/*
 * Copyright (C) 2026 PHYTEC Messtechnik GmbH
 */

/dts-v1/;
/plugin/;

&dram_sense {
	status = "okay";
};

&emmc_sense {
	status = "okay";
};

&ethphy_sense {
	status = "okay";
};

&pmic_sense {
	status = "okay";
};
