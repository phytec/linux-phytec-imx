// SPDX-License-Identifier: GPL-2.0
/*
 * Copyright (C) 2017 PHYTEC Messtechnik GmbH
 * Author: Christian Hemp <c.hemp@phytec.de>
 */

/dts-v1/;

#include "imx8qm-phycore-som.dtsi"
#include "imx8qm-pcm-943.dtsi"
