// SPDX-License-Identifier: GPL-2.0
/*
 * Copyright (C) 2023 PHYTEC Messtechnik GmbH
 * Author: Steffen Hemer <s.hemer@phytec.de>
 * Supports PEB-AV-013 connected to Toshiba tc358775 mipi-dsi bridge.
 */

/dts-v1/;
/plugin/;

#include "imx8mm-phyboard-polis-peb-av-013.dtsi"
#include "imx8mm-phycore-tc358775.dtsi"
