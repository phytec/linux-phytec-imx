// SPDX-License-Identifier: GPL-2.0
/*
 * Copyright (C) 2021 PHYTEC Messtechnik GmbH
 * Author: Teresa Remmet <t.remmet@phytec.de>
 */

/dts-v1/;
/plugin/;

/ {
	compatible = "phytec,imx8mm-phycore-som";
};

&ethphy0 {
	status = "disabled";
};
