// SPDX-License-Identifier: GPL-2.0
/*
 * Copyright (C) 2022 PHYTEC Messtechnik GmbH
 * Author: Cem Tenruh <c.tenruh@phytec.de>
 */

/dts-v1/;
/plugin/;

/ {
	compatible = "phytec,imx8mp-phycore-som";
};

&ethphy0 {
	status = "disabled";
};

&fec {
	status = "disabled";
};
