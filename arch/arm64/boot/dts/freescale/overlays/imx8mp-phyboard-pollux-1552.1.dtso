// SPDX-License-Identifier: GPL-2.0
/*
 * Copyright (C) 2021 PHYTEC Messtechnik GmbH
 * Author: Dominik Haller <d.haller@phytec.de>
 */

/dts-v1/;
/plugin/;

#include <dt-bindings/gpio/gpio.h>

/ {
	compatible = "phytec,imx8mp-phyboard-pollux-rdk";
};

&backlight1 {
	enable-gpios = <&gpio2 20 GPIO_ACTIVE_HIGH>;
};
