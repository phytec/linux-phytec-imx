// SPDX-License-Identifier: GPL-2.0
/*
 * Copyright (C) 2022 PHYTEC Messtechnik GmbH
 * Author: Teresa Remmet <t.remmet@phytec.de>
 *
 * phyCORE-i.MX8MM PMA-024 mapper support for alternativ ethernet
 * phy ADIN1300.
 *
 */

/dts-v1/;
/plugin/;

#include <dt-bindings/gpio/gpio.h>

/ {
        compatible = "phytec,imx8mm-phycore-som";
};

&fec1 {
	mdio {
		#address-cells = <1>;
		#size-cells = <0>;

		ethphy0: ethernet-phy@0 {
			compatible = "ethernet-phy-ieee802.3-c22";
			reg = <0>;
			reset-gpios = <&gpio1 7 GPIO_ACTIVE_HIGH>;
			reset-assert-us = <1000>;
			reset-deassert-us = <1000>;
		};
	};
};
