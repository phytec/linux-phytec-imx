// SPDX-License-Identifier: GPL-2.0
/*
 * Copyright (C) 2021 PHYTEC Messtechnik GmbH
 * Author: Dominik Haller <d.haller@phytec.de>
 */

/dts-v1/;

#include "imx8mq-phycore-som.dtsi"
#include "imx8mq-phyboard-polaris.dtsi"
#include "imx8mq-phyboard-polaris-sdcard.dtsi"
#include "imx8mq-phyboard-polaris-peb-av-009.dtsi"
#include "imx8mq-phyboard-polaris-peb-eval-01.dtsi"

/ {
	model = "PHYTEC phyBOARD-Polaris carrier board without 1.8v sdcard support";
	compatible = "phytec,imx8mq-pbacd12-emmc", "phytec,imx8mq-pbacd12",
		     "phytec,imx8mq-pcl066", "fsl,imx8mq";

	/delete-node/ regulator-usdhc2-vmmc;
};

&iomuxc {
	/delete-node/ usdhc2vmmcgpiogrp;
};

&usdhc1 {
	status = "okay";
};

&usdhc2 {
	vmmc-supply = <&reg_vcc3v3>;
	no-1-8-v;
	status = "okay";
};
