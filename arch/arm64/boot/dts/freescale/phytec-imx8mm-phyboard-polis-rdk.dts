// SPDX-License-Identifier: GPL-2.0
/*
 * Copyright (C) 2019 PHYTEC Messtechnik GmbH
 * Author: Teresa Remmet <t.remmet@phytec.de>
 */

/dts-v1/;

#include "phytec-imx8mm-phycore-som.dtsi"
#include "phytec-imx8mm-phyboard-polis.dtsi"
#include "phytec-imx8mm-phyboard-polis-peb-av-010.dtsi"

&i2c1_sn65dsi83 {
	status = "okay";
};
