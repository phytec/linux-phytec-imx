// SPDX-License-Identifier: (GPL-2.0+ OR MIT)
/*
 * Copyright (C) 2025 PHYTEC Messtechnik GmbH
 * Author: Stefan Riedmüller <s.riedmueller@phytec.de>
 */

/dts-v1/;
/plugin/;

&neoisp0 {
	status = "okay";
};
