// SPDX-License-Identifier: GPL-2.0-or-later
/*
 * Copyright (C) 2015-2022 PHYTEC America, LLC
 *
 * Support for PEB-AV-02-070W.A0 LCD adapter
 */

/dts-v1/;
/plugin/;

&panel {
	compatible = "edt,etm0700g0dh6";
};
