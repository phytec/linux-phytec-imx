// SPDX-License-Identifier: GPL-2.0-or-later
/*
 * Copyright (C) 2019-2023 PHYTEC America, LLC
 *
 * DTS for PHYTEC SOM PCM-061-0502100E and Carrier Board PBA-C-09.
 */

/dts-v1/;

#include "imx7s.dtsi"			/* Solo Processor */
#include "imx7-phycore-som.dtsi"	/* Enable all SOM population options */
#include "imx7s-pba-c-09.dtsi"		/* Carrier board */
#include "imx7-phycore-som-nand.dtsi"		/* NAND populated and eMMC not populated*/
#include "imx7-phycore-som-no-eth.dtsi"		/* No PHY on SOM */
#include "imx7-phycore-som-no-rtc.dtsi"		/* No external RTC */
#include "imx7-phycore-som-no-qspi.dtsi"		/* No SPI NOR */

/ {
	model = "PHYTEC phyCORE-i.MX7 Solo, 256MiB DDR3, NAND, Extended Temp";
	compatible = "phytec,imx7s-phyboard-zeta-0502100e",
			"phytec,imx7-phycore-som",
			"fsl,imx7d";

	memory@80000000 {
		device_type = "memory";
		reg = <0x80000000 0x10000000>;	/* 256MB */
	};
};
