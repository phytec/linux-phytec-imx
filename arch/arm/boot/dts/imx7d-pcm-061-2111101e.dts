// SPDX-License-Identifier: GPL-2.0-or-later
/*
 * Copyright (C) 2019-2021 PHYTEC America, LLC
 *
 * DTS for PHYTEC SOM PCM-061-2111101E and Carrier Board PBA-C-09.
 */

/dts-v1/;

#include "imx7d.dtsi"			/* Dual Processor */
#include "imx7-phycore-som.dtsi"	/* Enable all SOM population options */
#include "imx7d-pba-c-09.dtsi"		/* Carrier board */
#include "imx7-peb-av-02.dtsi"		/* Parallel LCD adapter */
#include "imx7-peb-d-rpi.dtsi"		/* PEB-D-RPI module */

/ {
	model = "PHYTEC phyCORE-i.MX7 Dual, 1GiB DDR3, Extended Temp";
	compatible = "phytec,imx7d-pcm-061-2111101e",
		     "phytec,imx7-phycore-som",
		     "fsl,imx7d";
};

/* ETH0 PHY not populated */
&ethphy0 {
	status = "disabled";
};

/* No CAN on MCIMX7D3EVK10SC */
&flexcan1 {
	status = "disabled";
};
