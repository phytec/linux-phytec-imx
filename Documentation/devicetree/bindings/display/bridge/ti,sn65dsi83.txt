## Documentation/devicetree/bindings/display/bridge/ti,sn65dsi83.txt
```
Texas Instrument SN65DSI83 DSI/LVDS bridge

Required properties:
- compatible: "ti,sn65dis83"
- reg: i2c address of the bridge
- lanes_in: Number of input lanes

Optional properties:
- lvds_vod_swing: Configure output voltage 0x00-0x3 (0x1 default).
			See datasheet for resulting voltages.

- port@0: panel node
- port@1: encoder node
Example:
	sn65dsi83@2c {
		compatible = "ti,sn65dsi83";
		reg = <0x2c>;

		ports {
			#address-cells = <1>;
			#size-cells = <0>;

			port@0 {
				reg = <0>;
				bridge_out: endpoint {
					remote-endpoint = <&panel_in>;
				};
			};
			port@1 {
				reg = <1>;
				bridge_in: endpoint {
					remote-endpoint = <&dsi_out>;
				};
			};
		};
	};
```

## Documentation/devicetree/bindings/display/panel/edt,etml1010g0dka.txt
```
Emerging Display Technologies Corporation 10" (1280x800) TFT-LCD panel

Requiered properties:
- compatible: should be "edt,etml1010g0dka"

This binding is compatible with the simple-panel binding, which is specified
in simple-panel.txt in this directory.
```

## Documentation/devicetree/bindings/display/panel/edtc,emtl1010g0dka.txt
```
Emerging Display Technologies Corporation 10" (1280x800) TFT-LCD panel

Requiered properties:
- compatible: should be "edtc,emtl1010g0dka"

Thicompatible with the simple-panel binding, which is specified
in simple-panel.txt in this directory.
```

## Documentation/devicetree/bindings/iio/adc/ti,ads1119.yaml
```yaml
# SPDX-License-Identifier: (GPL-2.0 OR BSD-2-Clause)
%YAML 1.2
---
$id: http://devicetree.org/schemas/iio/adc/ti,ads1119.yaml#
$schema: http://devicetree.org/meta-schemas/core.yaml#

title: TI ADS1119 4 channel I2C analog to digital converter

maintainers:
  - Felix Siebel <f.siebel@phytec.de>

description: |
  Datasheet at: https://www.ti.com/lit/gpn/ads1119
  Supports both single ended and differential channels.

properties:
  compatible:
    const: ti,ads1119

  reg:
    maxItems: 1

  "#address-cells":
    const: 1

  "#size-cells":
    const: 0

  "#io-channel-cells":
    const: 1

required:
  - compatible
  - reg
  - "#address-cells"
  - "#size-cells"

additionalProperties: false

patternProperties:
  "^channel@[0-7]+$":
    type: object
    description:
      Child nodes needed for each channel that the platform uses.

    properties:
      reg:
        description: |
          0: Voltage over AIN0 and AIN1. (default)
          1: Voltage over AIN2 and AIN3.
          2: Voltage over AIN1 and AIN2.
          3: Voltage over AIN0 and GND.
          4: Voltage over AIN1 and GND.
          5: Voltage over AIN2 and GND.
          6: Voltage over AIN3 and GND.
          7: Voltage over AINP and AINN shorted to AVDD/2.
        items:
          - minimum: 0
            maximum: 7

      ti,gain:
        $ref: /schemas/types.yaml#/definitions/uint32
        minimum: 1
        maximum: 4
        description: |
          pga is the programmable gain amplifier (+/- full scale)
          1: 1  +/- Refvoltage (default)
          4: 4  +/- Refvoltage/4

      ti,samplerate:
        $ref: /schemas/types.yaml#/definitions/uint32
        minimum: 20
        maximum: 1000
        description: |
          Data acquisition rate in samples per second
          20: 20 (default)
          90: 90
          330: 330
          1000: 1000

     ti,extref:
        $ref: /schemas/types.yaml#/definitions/uint32
        minimum: 0
        maximum: 1
        description: |
          Use external or internal reference voltage
          0: internal (2.048 V) reference voltage (default)
          1: external reference voltage

      ti,refvoltage:
        $ref: /schemas/types.yaml#/definitions/uint32
        minimum: 0
        maximum: 5500000
        description: |
          External reference voltage in uV used for calculation if "ti,extref=1" is specified

    required:
      - reg

examples:
  - |
    i2c {
        #address-cells = <1>;
        #size-cells = <0>;

        adc@41 {
            compatible = "ti,ads1119";
            reg = <0x41>;
            #address-cells = <1>;
            #size-cells = <0>;

            channel@0 {
                reg = <0>;
                ti,gain = <1>;
                ti,samplerate = <1000>;
                ti,extref = <1>;
                ti,refvoltage = <3300000>;
            };
        };
    };
...
```

## Documentation/devicetree/bindings/media/i2c/ti,ds90ub953.yaml
```yaml
# SPDX-License-Identifier: (GPL-2.0-only OR BSD-2-Clause)
# Copyright (C) 2021 PHYTEC Messtechnik GmbH
%YAML 1.2
---
$id: http://devicetree.org/schemas/media/i2c/ti,ds90ub953.yaml#
$schema: http://devicetree.org/meta-schemas/core.yaml#

title: TI DS90UB953 FPD-Link III Serializer

maintainers:
  - Stefan Riedmueller <s.riedmueller@phytec.de>

description: |
  The DS90UB953 Serializer features a MIPI-CSI2 input and a Flat Panel
  Display (FPD) Link III output. It works in combination with a DS90UB954
  Deserializer.

  The MIPI-CSI2 input supports up to 4 lanes.

  The FPD Link III link also encapsulates bidirectional I2C messages between
  the I2C busses connected to serializers and deserializer.

properties:
  '#address-cells':
    const: 1

  '#size-cells':
    const: 0

  compatible:
    const: ti,ds90ub953

  reg:
    description: I2C device address
    maxItems: 1

  gpio-controller: true

  '#gpio-cells':
    const: 2

  clocks:
    maxItems: 1

  clock-names:
    items:
      - const: refclk

  '#clock-cells':
    const: 0

  clock-output-names:
    items:
      - const: clkout_port0
      - const: clkout_port1

  clock-frequency:
    description: |
      Desired frequency for the CLKOUT reference clock
      which can be used as a master clock for a connected
      sensor.
    default: 27000000

  ports:
    type: object
    description: |
      The video connections between image sensor, serializer and deserializer
      are modelled using the OF graph bindings in accordance with the
      video interface bindings defined in
      Documentation/devicetree/bindings/media/video-interfaces.txt.

    properties:
      '#address-cells':
        const: 1

      '#size-cells':
        const: 0

      port@0:
        type: object
        properties:
          reg:
            const: 0

          endpoint:
            type: object

            properties:
              remote-endpoint:
                description: |
                  phandle to the camera sensors remote CSI-2 sink
                  endpoint.

            required:
              - remote-endpoint

        required:
          - reg
          - endpoint

        additionalProperties: false

      port@1:
        type: object
        properties:
          reg:
            const: 1

          endpoint:
            type: object

            properties:
              remote-endpoint:
                description: phandle to the remote deserializers endpoint

            required:
              - remote-endpoint

        required:
          - reg
          - endpoint

        additionalProperties: false

    additionalProperties: false

    required:
      - port@1

required:
  - compatible
  - reg
  - clocks
  - clock-names
  - gpio-controller
  - ports

additionalProperties: false

examples:
  - |
    #include <dt-bindings/gpio/gpio.h>

    i2c@0 {
      #address-cells = <1>;
      #size-cells = <0>;

      fpdlink@18 {
        compatible = "ti,ds90ub953";
        reg = <0x18>;

        clocks = <&ref_clk>;
        clock-names = "refclk";

        #clock-cells = <0>;
        clock-output-names = "clkout_port0";

        gpio-controller;
        #gpio-cells = <2>;

        ports {
          #address-cells = <1>;
          #size-cells = <0>;
          port@0 {
            reg = <0>;
            port0_ep: endpoint {
              remote-endpoint = <&cam0_mipi_ep>;
            };
          };

          port@1 {
            reg = <1>;
            port1_ep: endpoint {
              remote-endpoint = <&fpdiii_out_ep>;
            };
          };
        };
      };
    };
```
