## Documentation/devicetree/bindings/media/i2c/ti,ds90ub954.yaml
```yaml
# SPDX-License-Identifier: (GPL-2.0-only OR BSD-2-Clause)
# Copyright (C) 2021 PHYTEC Messtechnik GmbH
%YAML 1.2
---
$id: http://devicetree.org/schemas/media/i2c/ti,ds90ub954.yaml#
$schema: http://devicetree.org/meta-schemas/core.yaml#

title: TI DS90UB954 FPD-Link III Deserializer

maintainers:
  - Stefan Riedmueller <s.riedmueller@phytec.de>

description: |
  The DS90UB954 Deserializer features two Flat Panel Display (FPD) Link III
  connection inputs and one MIPI-CSI2 output. The D-PHY on the MIPI-CSI2
  output supports up to 4 lanes.
  The DS90UB954 works in combination with a DS90UB953 FPD Link III serializer.

  The FPD Link III link also encapsulates bidirectional I2C messages between
  the I2C busses connected to the serializers and deserializer. To prevent I2C
  address collisions between devices connected to the serializers only I2C
  messages are forwarded to the serializers which addresses have been
  configured in the deserializer. There is also a mechanism to use aliases for
  devices with the same address on each serializer but this is currently not
  supported.

  Currently only one port can be active and used at a time which is selected
  by media control link status.

properties:
  '#address-cells':
    const: 1

  '#size-cells':
    const: 0

  compatible:
    const: ti,ds90ub954

  reg:
    description: I2C device addresses
    minItems: 1
    maxItems: 3
    oneOf:
      - const: 0x3d
      - items:
        - description: I2C deserializer device address
          const: 0x3d
        - description: Internal Port0 register map address
        - description: Internal Port1 register map address

  reg-names:
    items:
      - const: device_id
      - const: rx0_id
      - const: rx1_id

  ti,reset-delay-ms:
            $ref: /schemas/types.yaml#/definitions/uint32
            description: Reset delay in milliseconds.
            default: 200

  ports:
    type: object
    description: |
      The video connections between sources and sink via the
      serializer/deserializer combination are modelled using the OF graph
      bindings in accordance with the video interface bindings defined in
      Documentation/devicetree/bindings/media/video-interfaces.txt.

      The following table lists the port number corresponding to each device
      port.

        Port            Description
        ----------------------------------------
        Port 0          Serializer Port 0 Input
        Port 1          Serializer Port 1 Input
        Port 2          Deserializer CSI-2 Output

    properties:
      '#address-cells':
        const: 1

      '#size-cells':
        const: 0

      port@[0-1]:
        type: object
        properties:
          reg:
            enum: [ 0, 1 ]

          ti,aeq-strobe-min:
            $ref: /schemas/types.yaml#/definitions/uint32
            description: Minimum AEQ strobe setting for this port
            default: 7
            minimum: 0
            maximum: 14
          ti,aeq-strobe-max:
            $ref: /schemas/types.yaml#/definitions/uint32
            description: Maximum AEQ strobe setting for this port
            default: 10
            minimum: 0
            maximum: 14
          ti,aeq-eq-min:
            $ref: /schemas/types.yaml#/definitions/uint32
            description: Minimum AEQ EQ setting for this port
            default: 2
            minimum: 0
            maximum: 14
          ti,aeq-eq-max:
            $ref: /schemas/types.yaml#/definitions/uint32
            description: Maximum AEQ EQ setting for this port
            default: 14
            minimum: 0
            maximum: 14

          endpoint:
            type: object

            properties:
              remote-endpoint:
                description: |
                 phandle to the remote sensor endpoint connected to the
                 corresponding serializer.

            required:
              - remote-endpoint

        required:
          - reg
          - endpoint

        additionalProperties: false

      port@2:
        type: object
        properties:
          reg:
            const: 2

          endpoint:
            type: object

            properties:
              remote-endpoint:
                description: phandle to the deserializers remote CSI-2 sink
                             endpoint.

              data-lanes:
                description: array of physical CSI-2 data lane indexes.

              link-frequencies:
                description: |
                  Maximum link frequencies of the interface.
                oneOf:
                  - const: 200000000
                  - const: 400000000
                  - const: 800000000

            required:
              - remote-endpoint
              - data-lanes
              - link-frequencies

        required:
          - reg
          - endpoint

        additionalProperties: false

    additionalProperties: false

    required:
      - port@2

  i2c-mux:
    type: object
    description: |
      Each FPD Link III port connected to the deserialzer is modelled as a
      child bus of an i2c bus multiplexer/switch, in accordance with bindings
      described in
      Documentation/devicetree/bindings/i2c/i2c-mux.txt.

    properties:
      '#address-cells':
        const: 1

      '#size-cells':
        const: 0

      i2c@[0-1]:
        type: object
        description: |
          Child node of the i2c bus multiplexer which represents a FPD Link III
          connection.
          Each serializer connected to either port of the deserializer is
          represented by a child node. 2 ports are supported.

        $ref: /schemas/i2c/i2c-controller.yaml#

        properties:
          '#address-cells':
            const: 1

          '#size-cells':
            const: 0

          reg:
            description: The index of the corresponding deserializer port.
            maxItems: 1

          clock-frequency:
            description: |
              Desired I2C bus frequency on the serializer bus.
              It is derived from the deserializer refclk which is
              fed to the serializer.
              This property is evaluated from the connected serializer.
            default: 400000
            minimum: 100000
            maximum: 1000000

        required:
          - reg

    additionalProperties: false

required:
  - compatible
  - reg
  - ports
  - i2c-mux

additionalProperties: false

examples:
  - |
    #include <dt-bindings/gpio/gpio.h>

    i2c0 {
      #address-cells = <1>;
      #size-cells = <0>;

      fpdlink@3d {
        compatible = "ti,ds90ub954";
        reg = <0x3d>;

        ports {
          #address-cells = <1>;
          #size-cells = <0>;
          port@0 {
            reg = <0>;
            port0_ep: endpoint {
              remote-endpoint = <&serializer0_link_ep>;
            };
          };

          port@1 {
            reg = <1>;
            port1_ep: endpoint {
              remote-endpoint = <&serializer1_link_ep>;
            };
          };

          port@2 {
            reg = <2>;
            mipi_out_ep: endpoint {
              remote-endpoint = <&mipi_csi0_ep>;
              data-lanes = <1 2>;
            };
          };
        };

        i2c-mux {
          #address-cells = <1>;
          #size-cells = <0>;

          i2c@0 {
            #address-cells = <1>;
            #size-cells = <0>;
            reg = <0>;

            clock-frequency = <400000>;

            serializer0: fpdlink@18 {
              compatible = "ti,ds90ub953";
              reg = <0x18>;

              clocks = <&ref_clk>;
              clock-names = "refclk";

              #clock-cells = <0>;
              clock-output-names = "clkout_port0";

              gpio-controller;
              #gpio-cells = <2>;

              ports {
                #address-cells = <1>;
                #size-cells = <0>;
                port@0 {
                  reg = <0>;
                  serializer0_ep: endpoint {
                    remote-endpoint = <&cam0_mipi_ep>;
                  };
                };
                port@1 {
                  reg = <1>;
                  serializer0_link_ep: endpoint {
                    remote-endpoint = <&port0_ep>;
                  };
                };
              };
            };

            cam0@36 {
              compatible = "onsemi,ar0144";
              reg = <0x36>;

              reset-gpios = <&serializer0 3 GPIO_ACTIVE_LOW>;
              clocks = <&serializer0>;
              clock-names = "ext";

              port {
                cam0_mipi_ep: endpoint {
                  remote-endpoint = <&serializer0_ep>;
                  data-lanes = <1 2>;
                };
              };
            };
          };

          i2c@1 {
            #address-cells = <1>;
            #size-cells = <0>;
            reg = <1>;

            clock-frequency = <400000>;

            serializer1: fpdlink@18 {
              compatible = "ti,ds90ub953";
              reg = <0x18>;

              clocks = <&ref_clk>;
              clock-names = "refclk";

              #clock-cells = <0>;
              clock-output-names = "clkout_port1";

              gpio-controller;
              #gpio-cells = <2>;

              ports {
                #address-cells = <1>;
                #size-cells = <0>;
                port@0 {
                  reg = <0>;
                  serializer1_ep: endpoint {
                    remote-endpoint = <&cam1_mipi_ep>;
                  };
                };
                port@1 {
                  reg = <1>;
                  serializer1_link_ep: endpoint {
                    remote-endpoint = <&port1_ep>;
                  };
                };
              };
            };

            cam1@36 {
              compatible = "onsemi,ar0144";
              reg = <0x36>;

              reset-gpios = <&serializer1 3 GPIO_ACTIVE_LOW>;
              clocks = <&serializer1>;
              clock-names = "ext";

              port {
                cam1_mipi_ep: endpoint {
                  remote-endpoint = <&serializer1_ep>;
                  data-lanes = <1 2>;
                };
              };

            };
          };
        };
      };
    };
```
